## modules/experimental/tinycc/native-qemu/sdkconfig.defaults
```kconfig
CONFIG_ESPTOOLPY_FLASHSIZE_8MB=y
CONFIG_FREERTOS_UNICORE=y
CONFIG_ESP_MAIN_TASK_STACK_SIZE=16384
CONFIG_ELF_LOADER_LIBC_SYMBOLS=n
CONFIG_ELF_LOADER_ESPIDF_SYMBOLS=n
CONFIG_SPIRAM=y
CONFIG_SPIRAM_MODE_QUAD=y
CONFIG_SPIRAM_SPEED_40M=y
CONFIG_SPIRAM_MEMTEST=n
CONFIG_ELF_LOADER_LOAD_PSRAM=y
```

## modules/experimental/tinycc/qemu/sdkconfig.defaults
```kconfig
CONFIG_ESPTOOLPY_FLASHSIZE_8MB=y
CONFIG_FREERTOS_UNICORE=y
CONFIG_ESP_MAIN_TASK_STACK_SIZE=16384
CONFIG_ELF_LOADER_LIBC_SYMBOLS=n
CONFIG_ELF_LOADER_ESPIDF_SYMBOLS=n
CONFIG_ELF_LOADER_LOAD_PSRAM=n
CONFIG_SPIRAM=n
CONFIG_ESP_SYSTEM_MEMPROT_FEATURE=n
```
