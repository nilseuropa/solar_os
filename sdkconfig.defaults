## sdkconfig.defaults
```kconfig
# ESP32-S3-RLCD-4.2 baseline from Waveshare's ESP-IDF examples.
CONFIG_IDF_TARGET="esp32s3"
CONFIG_ESPTOOLPY_FLASHMODE_QIO=y
CONFIG_ESPTOOLPY_FLASHSIZE_16MB=y
CONFIG_PARTITION_TABLE_CUSTOM=y
CONFIG_HTTPD_MAX_REQ_HDR_LEN=512
CONFIG_SPIRAM=y
CONFIG_SPIRAM_MODE_OCT=y
CONFIG_SPIRAM_SPEED_80M=y
CONFIG_SPIRAM_ALLOW_BSS_SEG_EXTERNAL_MEMORY=y
CONFIG_FATFS_LFN_HEAP=y
CONFIG_FATFS_VOLUME_COUNT=4
CONFIG_LWIP_IP_FORWARD=y
CONFIG_LWIP_IPV4_NAPT=y
CONFIG_LWIP_IPV4_NAPT_PORTMAP=y
CONFIG_ESP_HTTPS_OTA_ALLOW_HTTP=y
CONFIG_ESP_MAIN_TASK_STACK_SIZE=8192
CONFIG_FREERTOS_HZ=1000
CONFIG_PM_ENABLE=y
CONFIG_FREERTOS_USE_TICKLESS_IDLE=y
CONFIG_FREERTOS_IDLE_TIME_BEFORE_SLEEP=3
CONFIG_FREERTOS_USE_TRACE_FACILITY=y
CONFIG_FREERTOS_USE_STATS_FORMATTING_FUNCTIONS=y
CONFIG_FREERTOS_GENERATE_RUN_TIME_STATS=y
CONFIG_FREERTOS_RUN_TIME_COUNTER_TYPE_U32=y
CONFIG_FREERTOS_RUN_TIME_STATS_USING_ESP_TIMER=y
CONFIG_LIBSSH2_CRYPTO_ENGINE_MBEDTLS=y
# Keep libssh2 trace code out of the normal SolarOS image.
# CONFIG_LIBSSH2_DEBUG_ENABLE is not set
# Route console/log/stdout over native ESP32-S3 USB Serial/JTAG CDC ACM.
# This keeps UART0 pins free for SolarOS peripheral use.
# CONFIG_ESP_CONSOLE_UART_DEFAULT is not set
# CONFIG_ESP_CONSOLE_USB_CDC is not set
CONFIG_ESP_CONSOLE_USB_SERIAL_JTAG=y
# CONFIG_ESP_CONSOLE_UART_CUSTOM is not set
# CONFIG_ESP_CONSOLE_NONE is not set
CONFIG_ESP_CONSOLE_SECONDARY_NONE=y
# CONFIG_ESP_CONSOLE_SECONDARY_USB_SERIAL_JTAG is not set
CONFIG_BT_ENABLED=y
CONFIG_BT_BLUEDROID_ENABLED=y
CONFIG_BT_BLE_ENABLED=y
CONFIG_BT_BLE_42_FEATURES_SUPPORTED=y
CONFIG_BT_CTRL_MODEM_SLEEP=y
CONFIG_BT_CTRL_MODEM_SLEEP_MODE_1=y
CONFIG_BT_CTRL_LPCLK_SEL_MAIN_XTAL=y
CONFIG_BT_CTRL_MAIN_XTAL_PU_DURING_LIGHT_SLEEP=y
CONFIG_BT_GATTC_ENABLE=y
CONFIG_BT_GATTC_CACHE_NVS_FLASH=y
CONFIG_BT_GATTC_NOTIF_REG_MAX=16
```

## sdkconfig.defaults.elecrow_crowpanel_esp32_s3_4_2_epaper
```kconfig
# Elecrow CrowPanel ESP32-S3-WROOM-1-N8R8 baseline.
CONFIG_IDF_TARGET="esp32s3"
CONFIG_ESPTOOLPY_FLASHMODE_QIO=y
CONFIG_ESPTOOLPY_FLASHSIZE_8MB=y
CONFIG_PARTITION_TABLE_CUSTOM=y
CONFIG_HTTPD_MAX_REQ_HDR_LEN=512
CONFIG_SPIRAM=y
CONFIG_SPIRAM_MODE_OCT=y
CONFIG_SPIRAM_SPEED_80M=y
CONFIG_SPIRAM_ALLOW_BSS_SEG_EXTERNAL_MEMORY=y
CONFIG_SPIRAM_MALLOC_ALWAYSINTERNAL=0
CONFIG_SPIRAM_TRY_ALLOCATE_WIFI_LWIP=y
CONFIG_FREERTOS_TASK_CREATE_ALLOW_EXT_MEM=y
CONFIG_BT_ALLOCATION_FROM_SPIRAM_FIRST=y
CONFIG_FATFS_LFN_HEAP=y
CONFIG_FATFS_VOLUME_COUNT=4
CONFIG_LWIP_IP_FORWARD=y
CONFIG_LWIP_IPV4_NAPT=y
CONFIG_LWIP_IPV4_NAPT_PORTMAP=y
CONFIG_ESP_HTTPS_OTA_ALLOW_HTTP=y
CONFIG_MBEDTLS_DEFAULT_MEM_ALLOC=y
CONFIG_ESP_MAIN_TASK_STACK_SIZE=8192
CONFIG_FREERTOS_HZ=1000
CONFIG_PM_ENABLE=y
CONFIG_FREERTOS_USE_TICKLESS_IDLE=y
CONFIG_FREERTOS_IDLE_TIME_BEFORE_SLEEP=3
CONFIG_FREERTOS_USE_TRACE_FACILITY=y
CONFIG_FREERTOS_USE_STATS_FORMATTING_FUNCTIONS=y
CONFIG_FREERTOS_GENERATE_RUN_TIME_STATS=y
CONFIG_FREERTOS_RUN_TIME_COUNTER_TYPE_U32=y
CONFIG_FREERTOS_RUN_TIME_STATS_USING_ESP_TIMER=y
CONFIG_LIBSSH2_CRYPTO_ENGINE_MBEDTLS=y
# CONFIG_LIBSSH2_DEBUG_ENABLE is not set
# The board USB-C connector uses a CH340C bridge wired to UART0.
CONFIG_ESP_CONSOLE_UART_DEFAULT=y
# CONFIG_ESP_CONSOLE_USB_CDC is not set
# CONFIG_ESP_CONSOLE_USB_SERIAL_JTAG is not set
# CONFIG_ESP_CONSOLE_UART_CUSTOM is not set
# CONFIG_ESP_CONSOLE_NONE is not set
CONFIG_ESP_CONSOLE_SECONDARY_NONE=y
CONFIG_BT_ENABLED=y
CONFIG_BT_BLUEDROID_ENABLED=y
CONFIG_BT_BLE_ENABLED=y
CONFIG_BT_BLE_42_FEATURES_SUPPORTED=y
CONFIG_BT_CTRL_MODEM_SLEEP=y
CONFIG_BT_CTRL_MODEM_SLEEP_MODE_1=y
CONFIG_BT_CTRL_LPCLK_SEL_MAIN_XTAL=y
CONFIG_BT_CTRL_MAIN_XTAL_PU_DURING_LIGHT_SLEEP=y
CONFIG_BT_GATTC_ENABLE=y
CONFIG_BT_GATTC_CACHE_NVS_FLASH=y
CONFIG_BT_GATTC_NOTIF_REG_MAX=16
```

## sdkconfig.defaults.m5stack_core2
```kconfig
# M5Stack Core2 baseline for classic ESP32-D0WDQ6, 16MB flash / 8MB PSRAM.
CONFIG_IDF_TARGET="esp32"
CONFIG_ESPTOOLPY_FLASHMODE_QIO=y
CONFIG_ESPTOOLPY_FLASHFREQ_80M=y
CONFIG_ESPTOOLPY_FLASHSIZE_16MB=y
CONFIG_PARTITION_TABLE_CUSTOM=y
CONFIG_PARTITION_TABLE_CUSTOM_FILENAME="partitions.csv"
CONFIG_HTTPD_MAX_REQ_HDR_LEN=512
CONFIG_SPIRAM=y
CONFIG_SPIRAM_MODE_QUAD=y
CONFIG_SPIRAM_SPEED_40M=y
CONFIG_SPIRAM_ALLOW_BSS_SEG_EXTERNAL_MEMORY=y
# Same rev1 PSRAM cache workaround as odroid_go: keep it enabled, but
# don't pin optional libc helper groups into scarce classic ESP32 IRAM.
# CONFIG_SPIRAM_CACHE_LIBJMP_IN_IRAM is not set
# CONFIG_SPIRAM_CACHE_LIBMATH_IN_IRAM is not set
# CONFIG_SPIRAM_CACHE_LIBNUMPARSER_IN_IRAM is not set
# CONFIG_SPIRAM_CACHE_LIBIO_IN_IRAM is not set
# CONFIG_SPIRAM_CACHE_LIBTIME_IN_IRAM is not set
# CONFIG_SPIRAM_CACHE_LIBCHAR_IN_IRAM is not set
# CONFIG_SPIRAM_CACHE_LIBMEM_IN_IRAM is not set
# CONFIG_SPIRAM_CACHE_LIBSTR_IN_IRAM is not set
# CONFIG_SPIRAM_CACHE_LIBRAND_IN_IRAM is not set
# CONFIG_SPIRAM_CACHE_LIBENV_IN_IRAM is not set
# CONFIG_SPIRAM_CACHE_LIBFILE_IN_IRAM is not set
# CONFIG_SPIRAM_CACHE_LIBMISC_IN_IRAM is not set
# CONFIG_SPIRAM_BANKSWITCH_ENABLE is not set
# Keep SD/SPI on the shared VSPI bus from consuming scarce ESP32 IRAM.
# CONFIG_SPI_MASTER_ISR_IN_IRAM is not set
CONFIG_FATFS_LFN_HEAP=y
CONFIG_FATFS_VOLUME_COUNT=4
CONFIG_LWIP_IP_FORWARD=y
CONFIG_LWIP_IPV4_NAPT=y
CONFIG_LWIP_IPV4_NAPT_PORTMAP=y
CONFIG_ESP_HTTPS_OTA_ALLOW_HTTP=y
CONFIG_ESP_MAIN_TASK_STACK_SIZE=8192
CONFIG_FREERTOS_HZ=1000
CONFIG_PM_ENABLE=y
CONFIG_FREERTOS_USE_TICKLESS_IDLE=y
CONFIG_FREERTOS_IDLE_TIME_BEFORE_SLEEP=3
CONFIG_FREERTOS_USE_TRACE_FACILITY=y
CONFIG_FREERTOS_USE_STATS_FORMATTING_FUNCTIONS=y
CONFIG_FREERTOS_GENERATE_RUN_TIME_STATS=y
CONFIG_FREERTOS_RUN_TIME_COUNTER_TYPE_U32=y
CONFIG_FREERTOS_RUN_TIME_STATS_USING_ESP_TIMER=y
CONFIG_LIBSSH2_CRYPTO_ENGINE_MBEDTLS=y
# CONFIG_LIBSSH2_DEBUG_ENABLE is not set
# Use the Core2 USB-UART bridge (CP2104/CH9102) on IO1/IO3 as console.
CONFIG_ESP_CONSOLE_UART_DEFAULT=y
# CONFIG_ESP_CONSOLE_USB_CDC is not set
# CONFIG_ESP_CONSOLE_USB_SERIAL_JTAG is not set
# CONFIG_ESP_CONSOLE_UART_CUSTOM is not set
# CONFIG_ESP_CONSOLE_NONE is not set
CONFIG_ESP_CONSOLE_SECONDARY_NONE=y
CONFIG_BT_ENABLED=y
CONFIG_BT_BLUEDROID_ENABLED=y
CONFIG_BT_BLE_ENABLED=y
CONFIG_BT_GATTC_ENABLE=y
CONFIG_BT_GATTC_CACHE_NVS_FLASH=y
CONFIG_BT_GATTC_NOTIF_REG_MAX=16
```

## sdkconfig.defaults.m5stack_cores3
```kconfig
# M5Stack CoreS3: ESP32-S3, 16MB flash, 8MB Quad PSRAM. The project-wide
# sdkconfig.defaults assumes octal (OPI) PSRAM (matching the N16R8-family
# boards already in this repo); CoreS3's module is quad, not octal, so
# override that here. Target/flash size/console (native USB-Serial-JTAG)
# are already correct from the shared defaults.
CONFIG_SPIRAM_MODE_QUAD=y
# CONFIG_SPIRAM_MODE_OCT is not set
CONFIG_SPIRAM_SPEED_40M=y
# CONFIG_SPIRAM_SPEED_80M is not set
```

## sdkconfig.defaults.waveshare_esp32_s3_touch_lcd_5
```kconfig
# Waveshare ESP32-S3-Touch-LCD-5 specific defaults, applied on top of
# sdkconfig.defaults.
#
# The 800x480 RGB panel is fed continuously from the PSRAM frame
# buffer through CPU-filled bounce buffers, a steady ~45MB/s of PSRAM
# reads that competes with Wi-Fi and application traffic. At the
# shared default of 80MHz the margin is thin enough that the panel
# occasionally underruns (visible shimmer even on an idle screen).
# 120MHz octal (DDR) PSRAM -- the configuration the board vendor's own
# demo firmware ships with -- adds ~50% bandwidth headroom.
# IDF_EXPERIMENTAL_FEATURES is required to unlock 120MHz in octal
# mode.
#
# NOTE: do NOT add CONFIG_LCD_RGB_ISR_IRAM_SAFE here -- with the frame
# buffers in PSRAM it makes the bounce-refill ISR touch PSRAM while
# the flash cache is disabled (Cache-error panic at the first flash
# write). CONFIG_LCD_RGB_RESTART_IN_VSYNC is also known-bad here: it
# desynchronizes the bounce position from the panel scan (rolling
# frames, ghost lines).
CONFIG_IDF_EXPERIMENTAL_FEATURES=y
CONFIG_SPIRAM_SPEED_120M=y
# 120MHz PSRAM raises the shared MSPI core clock to 240MHz, which
# requires the flash to run at 120MHz as well (the 240M-core/80M-flash
# timing-tuning table does not exist). The board vendor's demo
# firmware ships this same 120/120 pairing.
CONFIG_ESPTOOLPY_FLASHFREQ_120M=y
```
