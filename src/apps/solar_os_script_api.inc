/*
 * Shared Python/Lua registration descriptor for the public SolarOS services.
 *
 * Define the SOLAR_OS_SCRIPT_API_* macros below before including this file.
 * The descriptor is intentionally re-includable: each interpreter expands the
 * same package-gated module, constant, alias, and nested-module declarations
 * into its native registration calls while retaining its own typed handlers.
 */

#ifndef SOLAR_OS_SCRIPT_API_MODULE_BEGIN
#error "SOLAR_OS_SCRIPT_API_MODULE_BEGIN must be defined"
#endif
#ifndef SOLAR_OS_SCRIPT_API_INT
#error "SOLAR_OS_SCRIPT_API_INT must be defined"
#endif
#ifndef SOLAR_OS_SCRIPT_API_UINT
#error "SOLAR_OS_SCRIPT_API_UINT must be defined"
#endif
#ifndef SOLAR_OS_SCRIPT_API_FUNCTION
#error "SOLAR_OS_SCRIPT_API_FUNCTION must be defined"
#endif
#ifndef SOLAR_OS_SCRIPT_API_FUNCTION_NAMED
#error "SOLAR_OS_SCRIPT_API_FUNCTION_NAMED must be defined"
#endif
#ifndef SOLAR_OS_SCRIPT_API_SUBMODULE_BEGIN
#error "SOLAR_OS_SCRIPT_API_SUBMODULE_BEGIN must be defined"
#endif
#ifndef SOLAR_OS_SCRIPT_API_SUBMODULE_FUNCTION
#error "SOLAR_OS_SCRIPT_API_SUBMODULE_FUNCTION must be defined"
#endif
#ifndef SOLAR_OS_SCRIPT_API_SUBMODULE_END
#error "SOLAR_OS_SCRIPT_API_SUBMODULE_END must be defined"
#endif
#ifndef SOLAR_OS_SCRIPT_API_MODULE_END
#error "SOLAR_OS_SCRIPT_API_MODULE_END must be defined"
#endif

SOLAR_OS_SCRIPT_API_MODULE_BEGIN(storage);
SOLAR_OS_SCRIPT_API_FUNCTION(storage, status, status);
SOLAR_OS_SCRIPT_API_FUNCTION(storage, is_mounted, is_mounted);
SOLAR_OS_SCRIPT_API_FUNCTION(storage, mount, mount);
SOLAR_OS_SCRIPT_API_FUNCTION(storage, unmount, unmount);
SOLAR_OS_SCRIPT_API_FUNCTION(storage, mount_point, mount_point);
SOLAR_OS_SCRIPT_API_FUNCTION(storage, usage, usage);
SOLAR_OS_SCRIPT_API_FUNCTION(storage, resolve, resolve);
SOLAR_OS_SCRIPT_API_FUNCTION(storage, read_file, read_file);
SOLAR_OS_SCRIPT_API_FUNCTION(storage, rescan, rescan);
SOLAR_OS_SCRIPT_API_FUNCTION(storage, blocks, blocks);
SOLAR_OS_SCRIPT_API_FUNCTION(storage, block_count, block_count);
SOLAR_OS_SCRIPT_API_FUNCTION(storage, block, block);
SOLAR_OS_SCRIPT_API_FUNCTION(storage, usage_for_block, usage_for_block);
SOLAR_OS_SCRIPT_API_FUNCTION(storage, mkdir, mkdir);
SOLAR_OS_SCRIPT_API_FUNCTION(storage, rmdir, rmdir);
SOLAR_OS_SCRIPT_API_FUNCTION(storage, remove, remove);
SOLAR_OS_SCRIPT_API_FUNCTION(storage, rename, rename);
SOLAR_OS_SCRIPT_API_FUNCTION(storage, copy, copy);
SOLAR_OS_SCRIPT_API_FUNCTION(storage, mount_volume, mount_volume);
SOLAR_OS_SCRIPT_API_FUNCTION(storage, unmount_volume, unmount_volume);
SOLAR_OS_SCRIPT_API_MODULE_END(storage);

SOLAR_OS_SCRIPT_API_MODULE_BEGIN(time);
SOLAR_OS_SCRIPT_API_FUNCTION(time, uptime_ms, uptime_ms);
SOLAR_OS_SCRIPT_API_FUNCTION(time, sleep_ms, sleep_ms);
SOLAR_OS_SCRIPT_API_FUNCTION(time, uptime, uptime);
SOLAR_OS_SCRIPT_API_FUNCTION(time, datetime, datetime);
SOLAR_OS_SCRIPT_API_FUNCTION(time, utc_datetime, utc_datetime);
SOLAR_OS_SCRIPT_API_FUNCTION(time, set_datetime, set_datetime);
SOLAR_OS_SCRIPT_API_FUNCTION(time, set_utc_datetime, set_utc_datetime);
SOLAR_OS_SCRIPT_API_FUNCTION(time, utc_to_local, utc_to_local);
SOLAR_OS_SCRIPT_API_FUNCTION(time, local_to_utc, local_to_utc);
SOLAR_OS_SCRIPT_API_FUNCTION(time, is_valid, is_valid);
SOLAR_OS_SCRIPT_API_FUNCTION(time, timezone, timezone);
SOLAR_OS_SCRIPT_API_FUNCTION(time, set_timezone, set_timezone);
SOLAR_OS_SCRIPT_API_FUNCTION(time, ntp_sync, ntp_sync);
SOLAR_OS_SCRIPT_API_MODULE_END(time);

#if SOLAR_OS_PACKAGE_SERVICE_BATTERY
SOLAR_OS_SCRIPT_API_MODULE_BEGIN(battery);
SOLAR_OS_SCRIPT_API_FUNCTION_NAMED(
    battery, status, solaros_battery_status_obj, solua_solaros_battery_status);
SOLAR_OS_SCRIPT_API_MODULE_END(battery);
#endif

#if SOLAR_OS_PACKAGE_SERVICE_SENSORS
SOLAR_OS_SCRIPT_API_MODULE_BEGIN(sensors);
SOLAR_OS_SCRIPT_API_FUNCTION(sensors, environment, environment);
SOLAR_OS_SCRIPT_API_MODULE_END(sensors);
#endif

#if SOLAR_OS_PACKAGE_SERVICE_WIFI
SOLAR_OS_SCRIPT_API_MODULE_BEGIN(wifi);
SOLAR_OS_SCRIPT_API_FUNCTION(wifi, status, status);
SOLAR_OS_SCRIPT_API_FUNCTION(wifi, status_text, status_text);
SOLAR_OS_SCRIPT_API_FUNCTION(wifi, start, start);
SOLAR_OS_SCRIPT_API_FUNCTION(wifi, stop, stop);
SOLAR_OS_SCRIPT_API_FUNCTION(wifi, connect, connect);
SOLAR_OS_SCRIPT_API_FUNCTION(wifi, connect_saved, connect_saved);
SOLAR_OS_SCRIPT_API_FUNCTION(wifi, disconnect, disconnect);
SOLAR_OS_SCRIPT_API_FUNCTION(wifi, forget, forget);
SOLAR_OS_SCRIPT_API_FUNCTION(wifi, forget_ssid, forget_ssid);
SOLAR_OS_SCRIPT_API_FUNCTION(wifi, forget_all, forget_all);
SOLAR_OS_SCRIPT_API_FUNCTION(wifi, known, known);
SOLAR_OS_SCRIPT_API_FUNCTION(wifi, scan, scan);
SOLAR_OS_SCRIPT_API_FUNCTION(wifi, ap_start, ap_start);
SOLAR_OS_SCRIPT_API_FUNCTION(wifi, ap_stop, ap_stop);
SOLAR_OS_SCRIPT_API_FUNCTION(wifi, nat, nat);
SOLAR_OS_SCRIPT_API_MODULE_END(wifi);
#endif

#if SOLAR_OS_PACKAGE_SERVICE_MQTT
SOLAR_OS_SCRIPT_API_MODULE_BEGIN(mqtt);
SOLAR_OS_SCRIPT_API_FUNCTION(mqtt, status, status);
SOLAR_OS_SCRIPT_API_FUNCTION(mqtt, connect, connect);
SOLAR_OS_SCRIPT_API_FUNCTION(mqtt, disconnect, disconnect);
SOLAR_OS_SCRIPT_API_FUNCTION(mqtt, publish, publish);
SOLAR_OS_SCRIPT_API_FUNCTION(mqtt, subscribe, subscribe);
SOLAR_OS_SCRIPT_API_FUNCTION(mqtt, read, read);
SOLAR_OS_SCRIPT_API_MODULE_END(mqtt);
#endif

#if SOLAR_OS_PACKAGE_SERVICE_HTTP_CLIENT
SOLAR_OS_SCRIPT_API_MODULE_BEGIN(http);
SOLAR_OS_SCRIPT_API_FUNCTION(http, request, request);
SOLAR_OS_SCRIPT_API_FUNCTION(http, get, get);
SOLAR_OS_SCRIPT_API_FUNCTION(http, post, post);
SOLAR_OS_SCRIPT_API_FUNCTION(http, put, put);
SOLAR_OS_SCRIPT_API_FUNCTION(http, patch, patch);
SOLAR_OS_SCRIPT_API_FUNCTION(http, delete, delete);
SOLAR_OS_SCRIPT_API_FUNCTION(http, head, head);
SOLAR_OS_SCRIPT_API_FUNCTION(http, session_open, session_open);
SOLAR_OS_SCRIPT_API_FUNCTION(http, session_request, session_request);
SOLAR_OS_SCRIPT_API_FUNCTION(http, session_close, session_close);
SOLAR_OS_SCRIPT_API_FUNCTION(http, session_close_all, session_close_all);
SOLAR_OS_SCRIPT_API_FUNCTION(http, stream_open, stream_open);
SOLAR_OS_SCRIPT_API_FUNCTION(http, stream_read, stream_read);
SOLAR_OS_SCRIPT_API_FUNCTION(http, stream_close, stream_close);
SOLAR_OS_SCRIPT_API_FUNCTION(http, stream_close_all, stream_close_all);
SOLAR_OS_SCRIPT_API_MODULE_END(http);
#endif

#if SOLAR_OS_PACKAGE_SERVICE_FTP
SOLAR_OS_SCRIPT_API_MODULE_BEGIN(ftp);
SOLAR_OS_SCRIPT_API_FUNCTION(ftp, list, list);
SOLAR_OS_SCRIPT_API_FUNCTION(ftp, download, download);
SOLAR_OS_SCRIPT_API_FUNCTION(ftp, upload, upload);
SOLAR_OS_SCRIPT_API_FUNCTION(ftp, mkdir, mkdir);
SOLAR_OS_SCRIPT_API_FUNCTION(ftp, rmdir, rmdir);
SOLAR_OS_SCRIPT_API_FUNCTION(ftp, remove, remove);
SOLAR_OS_SCRIPT_API_FUNCTION(ftp, rename, rename);
SOLAR_OS_SCRIPT_API_MODULE_END(ftp);
#endif

#if SOLAR_OS_PACKAGE_SERVICE_GPIO
SOLAR_OS_SCRIPT_API_MODULE_BEGIN(gpio);
SOLAR_OS_SCRIPT_API_INT(gpio, INPUT, SOLAR_OS_GPIO_MODE_INPUT);
SOLAR_OS_SCRIPT_API_INT(gpio, OUTPUT, SOLAR_OS_GPIO_MODE_OUTPUT);
SOLAR_OS_SCRIPT_API_INT(gpio, PULL_NONE, SOLAR_OS_GPIO_PULL_NONE);
SOLAR_OS_SCRIPT_API_INT(gpio, PULL_UP, SOLAR_OS_GPIO_PULL_UP);
SOLAR_OS_SCRIPT_API_INT(gpio, PULL_DOWN, SOLAR_OS_GPIO_PULL_DOWN);
SOLAR_OS_SCRIPT_API_FUNCTION(gpio, pins, pins);
SOLAR_OS_SCRIPT_API_FUNCTION(gpio, allowed, allowed);
SOLAR_OS_SCRIPT_API_FUNCTION(gpio, mode, mode);
SOLAR_OS_SCRIPT_API_FUNCTION(gpio, configure, mode);
SOLAR_OS_SCRIPT_API_FUNCTION(gpio, read, read);
SOLAR_OS_SCRIPT_API_FUNCTION(gpio, write, write);
SOLAR_OS_SCRIPT_API_FUNCTION(gpio, release, release);
SOLAR_OS_SCRIPT_API_MODULE_END(gpio);
#endif

#if SOLAR_OS_PACKAGE_SERVICE_ONEWIRE
SOLAR_OS_SCRIPT_API_MODULE_BEGIN(onewire);
SOLAR_OS_SCRIPT_API_FUNCTION(onewire, allowed, allowed);
SOLAR_OS_SCRIPT_API_FUNCTION(onewire, reset, reset);
SOLAR_OS_SCRIPT_API_FUNCTION(onewire, scan, scan);
SOLAR_OS_SCRIPT_API_FUNCTION(onewire, xfer, xfer);
SOLAR_OS_SCRIPT_API_MODULE_END(onewire);
#endif

#if SOLAR_OS_PACKAGE_SERVICE_GPIO
SOLAR_OS_SCRIPT_API_MODULE_BEGIN(led);
SOLAR_OS_SCRIPT_API_FUNCTION(led, status, status);
SOLAR_OS_SCRIPT_API_FUNCTION(led, set, set);
SOLAR_OS_SCRIPT_API_FUNCTION(led, on, on);
SOLAR_OS_SCRIPT_API_FUNCTION(led, off, off);
SOLAR_OS_SCRIPT_API_FUNCTION(led, toggle, toggle);
SOLAR_OS_SCRIPT_API_MODULE_END(led);
#endif

#if SOLAR_OS_PACKAGE_SERVICE_ADC
SOLAR_OS_SCRIPT_API_MODULE_BEGIN(adc);
SOLAR_OS_SCRIPT_API_FUNCTION(adc, pins, pins);
SOLAR_OS_SCRIPT_API_FUNCTION(adc, read, read);
SOLAR_OS_SCRIPT_API_MODULE_END(adc);
#endif

#if SOLAR_OS_PACKAGE_SERVICE_CONTROLS
SOLAR_OS_SCRIPT_API_MODULE_BEGIN(controls);
SOLAR_OS_SCRIPT_API_FUNCTION(controls, list, list);
SOLAR_OS_SCRIPT_API_FUNCTION(controls, get, get);
SOLAR_OS_SCRIPT_API_FUNCTION(controls, set, set);
SOLAR_OS_SCRIPT_API_FUNCTION(controls, create, create);
SOLAR_OS_SCRIPT_API_FUNCTION(controls, delete, delete);
SOLAR_OS_SCRIPT_API_FUNCTION(controls, clear, clear);
SOLAR_OS_SCRIPT_API_FUNCTION(controls, bindings, bindings);
SOLAR_OS_SCRIPT_API_FUNCTION(controls, bind_parameter, bind_parameter);
SOLAR_OS_SCRIPT_API_FUNCTION(controls, bind_midi, bind_midi);
SOLAR_OS_SCRIPT_API_FUNCTION(controls, unbind, unbind);
SOLAR_OS_SCRIPT_API_MODULE_END(controls);

SOLAR_OS_SCRIPT_API_MODULE_BEGIN(parameters);
SOLAR_OS_SCRIPT_API_FUNCTION(parameters, list, list);
SOLAR_OS_SCRIPT_API_FUNCTION(parameters, get, get);
SOLAR_OS_SCRIPT_API_FUNCTION(parameters, set, set);
SOLAR_OS_SCRIPT_API_MODULE_END(parameters);
#endif

#if SOLAR_OS_PACKAGE_SERVICE_MIDI
SOLAR_OS_SCRIPT_API_MODULE_BEGIN(midi);
SOLAR_OS_SCRIPT_API_FUNCTION(midi, status, status);
SOLAR_OS_SCRIPT_API_FUNCTION(midi, send, send);
SOLAR_OS_SCRIPT_API_FUNCTION(midi, note_on, note_on);
SOLAR_OS_SCRIPT_API_FUNCTION(midi, note_off, note_off);
SOLAR_OS_SCRIPT_API_FUNCTION(midi, cc, cc);
SOLAR_OS_SCRIPT_API_FUNCTION(midi, program, program);
SOLAR_OS_SCRIPT_API_FUNCTION(midi, read, read);
SOLAR_OS_SCRIPT_API_FUNCTION(midi, receive, read);
SOLAR_OS_SCRIPT_API_FUNCTION(midi, close, close);
SOLAR_OS_SCRIPT_API_FUNCTION(midi, streams, streams);
SOLAR_OS_SCRIPT_API_FUNCTION(midi, stream_add, stream_add);
SOLAR_OS_SCRIPT_API_FUNCTION(midi, stream_remove, stream_remove);
SOLAR_OS_SCRIPT_API_FUNCTION(midi, stream_clear, stream_clear);
SOLAR_OS_SCRIPT_API_MODULE_END(midi);
#endif

#if SOLAR_OS_PACKAGE_SERVICE_OSC
SOLAR_OS_SCRIPT_API_MODULE_BEGIN(osc);
SOLAR_OS_SCRIPT_API_FUNCTION(osc, bindings, bindings);
SOLAR_OS_SCRIPT_API_FUNCTION(osc, bind_stream, bind_stream);
SOLAR_OS_SCRIPT_API_FUNCTION(osc, bind_event, bind_event);
SOLAR_OS_SCRIPT_API_FUNCTION(osc, bind_control, bind_control);
SOLAR_OS_SCRIPT_API_FUNCTION(osc, unbind, unbind);
SOLAR_OS_SCRIPT_API_FUNCTION(osc, clear, clear);
SOLAR_OS_SCRIPT_API_FUNCTION(osc, encode_float, encode_float);
SOLAR_OS_SCRIPT_API_FUNCTION(osc, encode_int, encode_int);
SOLAR_OS_SCRIPT_API_FUNCTION(osc, dispatch, dispatch);
SOLAR_OS_SCRIPT_API_FUNCTION(osc, limits, limits);
SOLAR_OS_SCRIPT_API_MODULE_END(osc);
#endif

#if SOLAR_OS_PACKAGE_SERVICE_DSP
SOLAR_OS_SCRIPT_API_MODULE_BEGIN(dsp);
SOLAR_OS_SCRIPT_API_FUNCTION(dsp, backend, backend);
SOLAR_OS_SCRIPT_API_FUNCTION(dsp, capabilities, capabilities);
SOLAR_OS_SCRIPT_API_FUNCTION(dsp, dot, dot);
SOLAR_OS_SCRIPT_API_FUNCTION(dsp, gain, gain);
SOLAR_OS_SCRIPT_API_FUNCTION(dsp, mix, mix);
SOLAR_OS_SCRIPT_API_FUNCTION(dsp, clip, clip);
SOLAR_OS_SCRIPT_API_FUNCTION(dsp, level, level);
SOLAR_OS_SCRIPT_API_FUNCTION(dsp, window, window);
SOLAR_OS_SCRIPT_API_FUNCTION(dsp, fir, fir);
SOLAR_OS_SCRIPT_API_FUNCTION(dsp, fft, fft);
SOLAR_OS_SCRIPT_API_MODULE_END(dsp);
#endif

#if SOLAR_OS_PACKAGE_SERVICE_PWM
SOLAR_OS_SCRIPT_API_MODULE_BEGIN(pwm);
SOLAR_OS_SCRIPT_API_INT(pwm, FREQ_MIN, SOLAR_OS_PWM_FREQ_MIN_HZ);
SOLAR_OS_SCRIPT_API_INT(pwm, FREQ_MAX, SOLAR_OS_PWM_FREQ_MAX_HZ);
SOLAR_OS_SCRIPT_API_FUNCTION(pwm, status, status);
SOLAR_OS_SCRIPT_API_FUNCTION(pwm, set, set);
SOLAR_OS_SCRIPT_API_FUNCTION(pwm, off, off);
SOLAR_OS_SCRIPT_API_MODULE_END(pwm);
#endif

#if SOLAR_OS_PACKAGE_SERVICE_RESOURCES
SOLAR_OS_SCRIPT_API_MODULE_BEGIN(buses);
SOLAR_OS_SCRIPT_API_FUNCTION(buses, list, list);
SOLAR_OS_SCRIPT_API_FUNCTION(buses, get, get);
SOLAR_OS_SCRIPT_API_FUNCTION(buses, remove, remove);
SOLAR_OS_SCRIPT_API_FUNCTION(buses, attach, attach);
SOLAR_OS_SCRIPT_API_FUNCTION(buses, detach, detach);
#if SOLAR_OS_PACKAGE_SERVICE_SPI
SOLAR_OS_SCRIPT_API_INT(buses, MODE0, 0);
SOLAR_OS_SCRIPT_API_INT(buses, MODE1, 1);
SOLAR_OS_SCRIPT_API_INT(buses, MODE2, 2);
SOLAR_OS_SCRIPT_API_INT(buses, MODE3, 3);
SOLAR_OS_SCRIPT_API_INT(buses, SPI2_HOST, SPI2_HOST);
SOLAR_OS_SCRIPT_API_INT(buses, SPI3_HOST, SPI3_HOST);
SOLAR_OS_SCRIPT_API_UINT(buses, DEFAULT_SPEED, SOLAR_OS_BUS_SPI_DEFAULT_SPEED_HZ);
SOLAR_OS_SCRIPT_API_UINT(buses, MAX_SPEED, SOLAR_OS_BUS_SPI_MAX_SPEED_HZ);
SOLAR_OS_SCRIPT_API_FUNCTION(buses, create_spi, create_spi);
SOLAR_OS_SCRIPT_API_FUNCTION(buses, spi_xfer, spi_xfer);
SOLAR_OS_SCRIPT_API_FUNCTION(buses, spi_read, spi_read);
SOLAR_OS_SCRIPT_API_FUNCTION(buses, spi_write, spi_write);
#endif
#if SOLAR_OS_PACKAGE_SERVICE_I2C
SOLAR_OS_SCRIPT_API_FUNCTION(buses, create_i2c, create_i2c);
SOLAR_OS_SCRIPT_API_FUNCTION(buses, i2c_probe, i2c_probe);
SOLAR_OS_SCRIPT_API_FUNCTION(buses, i2c_scan, i2c_scan);
SOLAR_OS_SCRIPT_API_FUNCTION(buses, i2c_read_reg, i2c_read_reg);
SOLAR_OS_SCRIPT_API_FUNCTION(buses, i2c_write_reg, i2c_write_reg);
#endif
#if SOLAR_OS_PACKAGE_SERVICE_ONEWIRE
SOLAR_OS_SCRIPT_API_FUNCTION(buses, create_onewire, create_onewire);
SOLAR_OS_SCRIPT_API_FUNCTION(buses, onewire_reset, onewire_reset);
SOLAR_OS_SCRIPT_API_FUNCTION(buses, onewire_scan, onewire_scan);
SOLAR_OS_SCRIPT_API_FUNCTION(buses, onewire_xfer, onewire_xfer);
#endif
#if SOLAR_OS_PACKAGE_SERVICE_PS2
SOLAR_OS_SCRIPT_API_FUNCTION(buses, create_ps2, create_ps2);
#endif
#if SOLAR_OS_PACKAGE_SERVICE_UART
SOLAR_OS_SCRIPT_API_FUNCTION(buses, create_uart, create_uart);
SOLAR_OS_SCRIPT_API_FUNCTION(buses, create_midi, create_midi);
SOLAR_OS_SCRIPT_API_FUNCTION(buses, uart_write, uart_write);
SOLAR_OS_SCRIPT_API_FUNCTION(buses, uart_read, uart_read);
#endif
SOLAR_OS_SCRIPT_API_MODULE_END(buses);
#endif

#if SOLAR_OS_PACKAGE_SERVICE_EXPANSION
SOLAR_OS_SCRIPT_API_MODULE_BEGIN(expansion);
SOLAR_OS_SCRIPT_API_FUNCTION(expansion, drivers, drivers);
SOLAR_OS_SCRIPT_API_FUNCTION(expansion, devices, devices);
SOLAR_OS_SCRIPT_API_FUNCTION(expansion, attach, attach);
SOLAR_OS_SCRIPT_API_FUNCTION(expansion, detach, detach);
SOLAR_OS_SCRIPT_API_MODULE_END(expansion);
#endif

#if SOLAR_OS_PACKAGE_EXPANSION_NEOPIXEL
SOLAR_OS_SCRIPT_API_MODULE_BEGIN(neopixel);
SOLAR_OS_SCRIPT_API_FUNCTION(neopixel, list, list);
SOLAR_OS_SCRIPT_API_FUNCTION(neopixel, set, set);
SOLAR_OS_SCRIPT_API_FUNCTION(neopixel, fill, fill);
SOLAR_OS_SCRIPT_API_FUNCTION(neopixel, show, show);
SOLAR_OS_SCRIPT_API_FUNCTION(neopixel, clear, clear);
SOLAR_OS_SCRIPT_API_MODULE_END(neopixel);
#endif

#if SOLAR_OS_PACKAGE_SERVICE_I2C
SOLAR_OS_SCRIPT_API_MODULE_BEGIN(i2c);
SOLAR_OS_SCRIPT_API_FUNCTION(i2c, info, info);
SOLAR_OS_SCRIPT_API_FUNCTION(i2c, probe, probe);
SOLAR_OS_SCRIPT_API_FUNCTION(i2c, scan, scan);
SOLAR_OS_SCRIPT_API_FUNCTION(i2c, read_reg, read_reg);
SOLAR_OS_SCRIPT_API_FUNCTION(i2c, write_reg, write_reg);
SOLAR_OS_SCRIPT_API_MODULE_END(i2c);
#endif

#if SOLAR_OS_PACKAGE_SERVICE_SPI
SOLAR_OS_SCRIPT_API_MODULE_BEGIN(spi);
SOLAR_OS_SCRIPT_API_INT(spi, MODE0, 0);
SOLAR_OS_SCRIPT_API_INT(spi, MODE1, 1);
SOLAR_OS_SCRIPT_API_INT(spi, MODE2, 2);
SOLAR_OS_SCRIPT_API_INT(spi, MODE3, 3);
SOLAR_OS_SCRIPT_API_UINT(spi, DEFAULT_SPEED, SOLAR_OS_SPI_DEFAULT_SPEED_HZ);
SOLAR_OS_SCRIPT_API_UINT(spi, MAX_SPEED, SOLAR_OS_SPI_MAX_SPEED_HZ);
SOLAR_OS_SCRIPT_API_FUNCTION(spi, status, status);
SOLAR_OS_SCRIPT_API_FUNCTION(spi, xfer, xfer);
SOLAR_OS_SCRIPT_API_FUNCTION(spi, read, read);
SOLAR_OS_SCRIPT_API_FUNCTION(spi, write, write);
SOLAR_OS_SCRIPT_API_MODULE_END(spi);
#endif

#if SOLAR_OS_PACKAGE_SERVICE_UART
SOLAR_OS_SCRIPT_API_MODULE_BEGIN(uart);
SOLAR_OS_SCRIPT_API_FUNCTION(uart, status, status);
SOLAR_OS_SCRIPT_API_FUNCTION(uart, baud, baud);
SOLAR_OS_SCRIPT_API_FUNCTION(uart, is_valid_baud, is_valid_baud);
SOLAR_OS_SCRIPT_API_FUNCTION(uart, mode, mode);
SOLAR_OS_SCRIPT_API_FUNCTION(uart, write, write);
SOLAR_OS_SCRIPT_API_FUNCTION(uart, read, read);
SOLAR_OS_SCRIPT_API_MODULE_END(uart);
#endif

#if SOLAR_OS_PACKAGE_SERVICE_AUDIO
SOLAR_OS_SCRIPT_API_MODULE_BEGIN(audio);
SOLAR_OS_SCRIPT_API_FUNCTION(audio, status, status);
SOLAR_OS_SCRIPT_API_FUNCTION(audio, deinit, deinit);
SOLAR_OS_SCRIPT_API_FUNCTION(audio, off, deinit);
SOLAR_OS_SCRIPT_API_FUNCTION(audio, set_volume, set_volume);
SOLAR_OS_SCRIPT_API_FUNCTION(audio, set_mic_gain, set_mic_gain);
SOLAR_OS_SCRIPT_API_FUNCTION(audio, tone, tone);
SOLAR_OS_SCRIPT_API_FUNCTION(audio, tone_async, tone_async);
SOLAR_OS_SCRIPT_API_FUNCTION(audio, cancel, cancel);
SOLAR_OS_SCRIPT_API_FUNCTION(audio, queue_status, queue_status);
SOLAR_OS_SCRIPT_API_FUNCTION(audio, level, level);
SOLAR_OS_SCRIPT_API_FUNCTION(audio, capture, capture);
SOLAR_OS_SCRIPT_API_FUNCTION(audio, loopback, loopback);
SOLAR_OS_SCRIPT_API_FUNCTION(audio, wav_info, wav_info);
SOLAR_OS_SCRIPT_API_FUNCTION(audio, record_wav, record_wav);
SOLAR_OS_SCRIPT_API_FUNCTION(audio, play_wav, play_wav);
SOLAR_OS_SCRIPT_API_MODULE_END(audio);
#endif

#if SOLAR_OS_PACKAGE_SERVICE_SYNTH
SOLAR_OS_SCRIPT_API_MODULE_BEGIN(synth);
SOLAR_OS_SCRIPT_API_FUNCTION(synth, status, status);
SOLAR_OS_SCRIPT_API_FUNCTION(synth, configure, configure);
SOLAR_OS_SCRIPT_API_FUNCTION(synth, configure_filter, configure_filter);
SOLAR_OS_SCRIPT_API_FUNCTION(synth, configure_oscillator2, configure_oscillator2);
SOLAR_OS_SCRIPT_API_FUNCTION(synth, configure_performance, configure_performance);
SOLAR_OS_SCRIPT_API_FUNCTION(synth, note_on, note_on);
SOLAR_OS_SCRIPT_API_FUNCTION(synth, note_off, note_off);
SOLAR_OS_SCRIPT_API_FUNCTION(synth, all_notes_off, all_notes_off);
SOLAR_OS_SCRIPT_API_FUNCTION(synth, stop, stop);
SOLAR_OS_SCRIPT_API_MODULE_END(synth);
#endif

#if SOLAR_OS_PACKAGE_SERVICE_BLE
SOLAR_OS_SCRIPT_API_MODULE_BEGIN(ble);
SOLAR_OS_SCRIPT_API_FUNCTION(ble, status, status);
SOLAR_OS_SCRIPT_API_FUNCTION(ble, connected, connected);
SOLAR_OS_SCRIPT_API_FUNCTION(ble, pair, pair);
SOLAR_OS_SCRIPT_API_FUNCTION(ble, forget, forget);
SOLAR_OS_SCRIPT_API_FUNCTION(ble, layout, layout);
SOLAR_OS_SCRIPT_API_FUNCTION(ble, read, read);
SOLAR_OS_SCRIPT_API_MODULE_END(ble);
#endif

#if SOLAR_OS_PACKAGE_SERVICE_HID
SOLAR_OS_SCRIPT_API_MODULE_BEGIN(hid);
SOLAR_OS_SCRIPT_API_FUNCTION(hid, status, status);
#define SOLAR_OS_HID_KEY_CONSTANT(name, value) \
    SOLAR_OS_SCRIPT_API_INT(hid, name, value);
#include "solar_os_hid_keycodes.inc"
#undef SOLAR_OS_HID_KEY_CONSTANT
SOLAR_OS_SCRIPT_API_INT(hid, KEY_LEFT_CTRL, SOLAR_OS_HID_KEY_LEFT_CTRL);
SOLAR_OS_SCRIPT_API_INT(hid, KEY_LEFT_SHIFT, SOLAR_OS_HID_KEY_LEFT_SHIFT);
SOLAR_OS_SCRIPT_API_INT(hid, KEY_LEFT_ALT, SOLAR_OS_HID_KEY_LEFT_ALT);
SOLAR_OS_SCRIPT_API_INT(hid, KEY_LEFT_GUI, SOLAR_OS_HID_KEY_LEFT_GUI);
SOLAR_OS_SCRIPT_API_INT(hid, KEY_RIGHT_CTRL, SOLAR_OS_HID_KEY_RIGHT_CTRL);
SOLAR_OS_SCRIPT_API_INT(hid, KEY_RIGHT_SHIFT, SOLAR_OS_HID_KEY_RIGHT_SHIFT);
SOLAR_OS_SCRIPT_API_INT(hid, KEY_RIGHT_ALT, SOLAR_OS_HID_KEY_RIGHT_ALT);
SOLAR_OS_SCRIPT_API_INT(hid, KEY_RIGHT_GUI, SOLAR_OS_HID_KEY_RIGHT_GUI);
SOLAR_OS_SCRIPT_API_INT(hid, MOUSE_LEFT, SOLAR_OS_HID_MOUSE_LEFT);
SOLAR_OS_SCRIPT_API_INT(hid, MOUSE_RIGHT, SOLAR_OS_HID_MOUSE_RIGHT);
SOLAR_OS_SCRIPT_API_INT(hid, MOUSE_MIDDLE, SOLAR_OS_HID_MOUSE_MIDDLE);
SOLAR_OS_SCRIPT_API_INT(hid, MOUSE_BACK, SOLAR_OS_HID_MOUSE_BACK);
SOLAR_OS_SCRIPT_API_INT(hid, MOUSE_FORWARD, SOLAR_OS_HID_MOUSE_FORWARD);
SOLAR_OS_SCRIPT_API_INT(hid, AXIS_X, SOLAR_OS_HID_AXIS_X);
SOLAR_OS_SCRIPT_API_INT(hid, AXIS_Y, SOLAR_OS_HID_AXIS_Y);
SOLAR_OS_SCRIPT_API_INT(hid, AXIS_Z, SOLAR_OS_HID_AXIS_Z);
SOLAR_OS_SCRIPT_API_INT(hid, AXIS_RZ, SOLAR_OS_HID_AXIS_RZ);
SOLAR_OS_SCRIPT_API_INT(hid, AXIS_RX, SOLAR_OS_HID_AXIS_RX);
SOLAR_OS_SCRIPT_API_INT(hid, AXIS_RY, SOLAR_OS_HID_AXIS_RY);
SOLAR_OS_SCRIPT_API_INT(hid, HAT_CENTERED, SOLAR_OS_HID_HAT_CENTERED);
SOLAR_OS_SCRIPT_API_INT(hid, HAT_UP, SOLAR_OS_HID_HAT_UP);
SOLAR_OS_SCRIPT_API_INT(hid, HAT_UP_RIGHT, SOLAR_OS_HID_HAT_UP_RIGHT);
SOLAR_OS_SCRIPT_API_INT(hid, HAT_RIGHT, SOLAR_OS_HID_HAT_RIGHT);
SOLAR_OS_SCRIPT_API_INT(hid, HAT_DOWN_RIGHT, SOLAR_OS_HID_HAT_DOWN_RIGHT);
SOLAR_OS_SCRIPT_API_INT(hid, HAT_DOWN, SOLAR_OS_HID_HAT_DOWN);
SOLAR_OS_SCRIPT_API_INT(hid, HAT_DOWN_LEFT, SOLAR_OS_HID_HAT_DOWN_LEFT);
SOLAR_OS_SCRIPT_API_INT(hid, HAT_LEFT, SOLAR_OS_HID_HAT_LEFT);
SOLAR_OS_SCRIPT_API_INT(hid, HAT_UP_LEFT, SOLAR_OS_HID_HAT_UP_LEFT);
SOLAR_OS_SCRIPT_API_SUBMODULE_BEGIN(hid, keyboard);
SOLAR_OS_SCRIPT_API_SUBMODULE_FUNCTION(hid, keyboard, press, press);
SOLAR_OS_SCRIPT_API_SUBMODULE_FUNCTION(hid, keyboard, release, release);
SOLAR_OS_SCRIPT_API_SUBMODULE_FUNCTION(hid, keyboard, release_all, release_all);
SOLAR_OS_SCRIPT_API_SUBMODULE_END(hid, keyboard);
SOLAR_OS_SCRIPT_API_SUBMODULE_BEGIN(hid, mouse);
SOLAR_OS_SCRIPT_API_SUBMODULE_FUNCTION(hid, mouse, move, move);
SOLAR_OS_SCRIPT_API_SUBMODULE_FUNCTION(hid, mouse, button, button);
SOLAR_OS_SCRIPT_API_SUBMODULE_END(hid, mouse);
SOLAR_OS_SCRIPT_API_SUBMODULE_BEGIN(hid, gamepad);
SOLAR_OS_SCRIPT_API_SUBMODULE_FUNCTION(hid, gamepad, axis, axis);
SOLAR_OS_SCRIPT_API_SUBMODULE_FUNCTION(hid, gamepad, button, button);
SOLAR_OS_SCRIPT_API_SUBMODULE_FUNCTION(hid, gamepad, hat, hat);
SOLAR_OS_SCRIPT_API_SUBMODULE_FUNCTION(hid, gamepad, send, send);
SOLAR_OS_SCRIPT_API_SUBMODULE_END(hid, gamepad);
SOLAR_OS_SCRIPT_API_MODULE_END(hid);
#endif

SOLAR_OS_SCRIPT_API_MODULE_BEGIN(clipboard);
SOLAR_OS_SCRIPT_API_FUNCTION(clipboard, set, set);
SOLAR_OS_SCRIPT_API_FUNCTION(clipboard, get, get);
SOLAR_OS_SCRIPT_API_FUNCTION(clipboard, size, size);
SOLAR_OS_SCRIPT_API_FUNCTION(clipboard, clear, clear);
SOLAR_OS_SCRIPT_API_MODULE_END(clipboard);

SOLAR_OS_SCRIPT_API_MODULE_BEGIN(identity);
SOLAR_OS_SCRIPT_API_FUNCTION(identity, user, user);
SOLAR_OS_SCRIPT_API_FUNCTION(identity, hostname, hostname);
SOLAR_OS_SCRIPT_API_FUNCTION(identity, set_user, set_user);
SOLAR_OS_SCRIPT_API_FUNCTION(identity, set_hostname, set_hostname);
SOLAR_OS_SCRIPT_API_FUNCTION(identity, format, format);
SOLAR_OS_SCRIPT_API_MODULE_END(identity);

#if SOLAR_OS_PACKAGE_SERVICE_NET
SOLAR_OS_SCRIPT_API_MODULE_BEGIN(net);
SOLAR_OS_SCRIPT_API_FUNCTION(net, ping, ping);
SOLAR_OS_SCRIPT_API_FUNCTION(net, tcp_connect, tcp_connect);
SOLAR_OS_SCRIPT_API_FUNCTION(net, tcp_send, tcp_send);
SOLAR_OS_SCRIPT_API_FUNCTION(net, tcp_receive, tcp_receive);
SOLAR_OS_SCRIPT_API_FUNCTION(net, udp_open, udp_open);
SOLAR_OS_SCRIPT_API_FUNCTION(net, udp_send, udp_send);
SOLAR_OS_SCRIPT_API_FUNCTION(net, udp_receive, udp_receive);
SOLAR_OS_SCRIPT_API_FUNCTION(net, websocket_connect, websocket_connect);
SOLAR_OS_SCRIPT_API_FUNCTION(net, websocket_send, websocket_send);
SOLAR_OS_SCRIPT_API_FUNCTION(net, websocket_receive, websocket_receive);
SOLAR_OS_SCRIPT_API_FUNCTION(net, close, close);
SOLAR_OS_SCRIPT_API_FUNCTION(net, close_all, close_all);
SOLAR_OS_SCRIPT_API_FUNCTION(net, limits, limits);
SOLAR_OS_SCRIPT_API_MODULE_END(net);
#endif

#if SOLAR_OS_PACKAGE_SERVICE_SSH
SOLAR_OS_SCRIPT_API_MODULE_BEGIN(ssh_keys);
SOLAR_OS_SCRIPT_API_FUNCTION(ssh_keys, default_paths, default_paths);
SOLAR_OS_SCRIPT_API_FUNCTION(ssh_keys, default_exists, default_exists);
SOLAR_OS_SCRIPT_API_FUNCTION(ssh_keys, status, status);
SOLAR_OS_SCRIPT_API_FUNCTION(ssh_keys, public_key, public_key);
SOLAR_OS_SCRIPT_API_FUNCTION(ssh_keys, generate, generate);
SOLAR_OS_SCRIPT_API_FUNCTION(ssh_keys, remove, remove);
SOLAR_OS_SCRIPT_API_MODULE_END(ssh_keys);
#endif

SOLAR_OS_SCRIPT_API_MODULE_BEGIN(jobs);
SOLAR_OS_SCRIPT_API_FUNCTION(jobs, list, list);
SOLAR_OS_SCRIPT_API_FUNCTION(jobs, count, count);
SOLAR_OS_SCRIPT_API_FUNCTION(jobs, status, status);
SOLAR_OS_SCRIPT_API_FUNCTION(jobs, start, start);
SOLAR_OS_SCRIPT_API_FUNCTION(jobs, stop, stop);
SOLAR_OS_SCRIPT_API_MODULE_END(jobs);

SOLAR_OS_SCRIPT_API_MODULE_BEGIN(contacts);
SOLAR_OS_SCRIPT_API_FUNCTION(contacts, list, list);
SOLAR_OS_SCRIPT_API_FUNCTION(contacts, get, get);
SOLAR_OS_SCRIPT_API_MODULE_END(contacts);

SOLAR_OS_SCRIPT_API_MODULE_BEGIN(messages);
SOLAR_OS_SCRIPT_API_FUNCTION(messages, conversations, conversations);
SOLAR_OS_SCRIPT_API_FUNCTION(messages, list, list);
SOLAR_OS_SCRIPT_API_FUNCTION(messages, send, send);
SOLAR_OS_SCRIPT_API_FUNCTION(messages, mark_read, mark_read);
SOLAR_OS_SCRIPT_API_FUNCTION(messages, cancel, cancel);
SOLAR_OS_SCRIPT_API_MODULE_END(messages);

SOLAR_OS_SCRIPT_API_MODULE_BEGIN(sessions);
SOLAR_OS_SCRIPT_API_FUNCTION(sessions, create_shell, create_shell);
SOLAR_OS_SCRIPT_API_FUNCTION(sessions, close, close);
SOLAR_OS_SCRIPT_API_MODULE_END(sessions);

SOLAR_OS_SCRIPT_API_MODULE_BEGIN(apps);
SOLAR_OS_SCRIPT_API_FUNCTION(apps, list, list);
SOLAR_OS_SCRIPT_API_FUNCTION(apps, find, find);
SOLAR_OS_SCRIPT_API_MODULE_END(apps);

SOLAR_OS_SCRIPT_API_MODULE_BEGIN(input);
SOLAR_OS_SCRIPT_API_INT(input, SOURCE_OTHER, SOLAR_OS_INPUT_SOURCE_OTHER);
SOLAR_OS_SCRIPT_API_INT(input, SOURCE_KEYBOARD, SOLAR_OS_INPUT_SOURCE_KEYBOARD);
SOLAR_OS_SCRIPT_API_INT(input, SOURCE_TOUCH, SOLAR_OS_INPUT_SOURCE_TOUCH);
SOLAR_OS_SCRIPT_API_INT(input, SOURCE_MOUSE, SOLAR_OS_INPUT_SOURCE_MOUSE);
SOLAR_OS_SCRIPT_API_INT(input, SOURCE_JOYSTICK, SOLAR_OS_INPUT_SOURCE_JOYSTICK);
SOLAR_OS_SCRIPT_API_INT(input, SOURCE_DPAD, SOLAR_OS_INPUT_SOURCE_DPAD);
SOLAR_OS_SCRIPT_API_INT(input, SOURCE_BUTTONS, SOLAR_OS_INPUT_SOURCE_BUTTONS);
SOLAR_OS_SCRIPT_API_UINT(input, CAP_KEY_EVENTS, SOLAR_OS_INPUT_CAP_KEY_EVENTS);
SOLAR_OS_SCRIPT_API_UINT(input, CAP_POINTER_ABSOLUTE, SOLAR_OS_INPUT_CAP_POINTER_ABSOLUTE);
SOLAR_OS_SCRIPT_API_UINT(input, CAP_POINTER_RELATIVE, SOLAR_OS_INPUT_CAP_POINTER_RELATIVE);
SOLAR_OS_SCRIPT_API_UINT(input, CAP_POINTER_BUTTONS, SOLAR_OS_INPUT_CAP_POINTER_BUTTONS);
SOLAR_OS_SCRIPT_API_UINT(input, CAP_SCROLL, SOLAR_OS_INPUT_CAP_SCROLL);
SOLAR_OS_SCRIPT_API_UINT(input, CAP_AXIS_EVENTS, SOLAR_OS_INPUT_CAP_AXIS_EVENTS);
SOLAR_OS_SCRIPT_API_INT(input, MODE_ABSOLUTE, SOLAR_OS_INPUT_POINTER_ABSOLUTE);
SOLAR_OS_SCRIPT_API_INT(input, MODE_RELATIVE, SOLAR_OS_INPUT_POINTER_RELATIVE);
SOLAR_OS_SCRIPT_API_INT(input, ACTION_MOVE, SOLAR_OS_INPUT_POINTER_MOVE);
SOLAR_OS_SCRIPT_API_INT(input, ACTION_PRESS, SOLAR_OS_INPUT_POINTER_PRESS);
SOLAR_OS_SCRIPT_API_INT(input, ACTION_RELEASE, SOLAR_OS_INPUT_POINTER_RELEASE);
SOLAR_OS_SCRIPT_API_UINT(input, BUTTON_PRIMARY, SOLAR_OS_INPUT_POINTER_BUTTON_PRIMARY);
SOLAR_OS_SCRIPT_API_UINT(input, BUTTON_SECONDARY, SOLAR_OS_INPUT_POINTER_BUTTON_SECONDARY);
SOLAR_OS_SCRIPT_API_UINT(input, BUTTON_MIDDLE, SOLAR_OS_INPUT_POINTER_BUTTON_MIDDLE);
SOLAR_OS_SCRIPT_API_INT(input, AXIS_X, SOLAR_OS_INPUT_AXIS_X);
SOLAR_OS_SCRIPT_API_INT(input, AXIS_Y, SOLAR_OS_INPUT_AXIS_Y);
SOLAR_OS_SCRIPT_API_INT(input, AXIS_Z, SOLAR_OS_INPUT_AXIS_Z);
SOLAR_OS_SCRIPT_API_INT(input, AXIS_RX, SOLAR_OS_INPUT_AXIS_RX);
SOLAR_OS_SCRIPT_API_INT(input, AXIS_RY, SOLAR_OS_INPUT_AXIS_RY);
SOLAR_OS_SCRIPT_API_INT(input, AXIS_RZ, SOLAR_OS_INPUT_AXIS_RZ);
SOLAR_OS_SCRIPT_API_FUNCTION(input, sources, sources);
SOLAR_OS_SCRIPT_API_FUNCTION(input, read, read);
SOLAR_OS_SCRIPT_API_FUNCTION(input, clear, clear);
SOLAR_OS_SCRIPT_API_FUNCTION(input, status, status);
SOLAR_OS_SCRIPT_API_MODULE_END(input);

SOLAR_OS_SCRIPT_API_MODULE_BEGIN(tui);
SOLAR_OS_SCRIPT_API_INT(tui, NORMAL, SOLAR_OS_TUI_ATTR_NORMAL);
SOLAR_OS_SCRIPT_API_INT(tui, BOLD, SOLAR_OS_TUI_ATTR_BOLD);
SOLAR_OS_SCRIPT_API_INT(tui, INVERSE, SOLAR_OS_TUI_ATTR_INVERSE);
SOLAR_OS_SCRIPT_API_INT(tui, ITALIC, SOLAR_OS_TUI_ATTR_ITALIC);
SOLAR_OS_SCRIPT_API_INT(tui, UNDERLINE, SOLAR_OS_TUI_ATTR_UNDERLINE);
SOLAR_OS_SCRIPT_API_INT(tui, KEY_UP, SOLAR_OS_KEY_UP);
SOLAR_OS_SCRIPT_API_INT(tui, KEY_DOWN, SOLAR_OS_KEY_DOWN);
SOLAR_OS_SCRIPT_API_INT(tui, KEY_LEFT, SOLAR_OS_KEY_LEFT);
SOLAR_OS_SCRIPT_API_INT(tui, KEY_RIGHT, SOLAR_OS_KEY_RIGHT);
SOLAR_OS_SCRIPT_API_INT(tui, KEY_CTRL_LEFT, SOLAR_OS_KEY_CTRL_LEFT);
SOLAR_OS_SCRIPT_API_INT(tui, KEY_CTRL_RIGHT, SOLAR_OS_KEY_CTRL_RIGHT);
SOLAR_OS_SCRIPT_API_INT(tui, KEY_HOME, SOLAR_OS_KEY_HOME);
SOLAR_OS_SCRIPT_API_INT(tui, KEY_END, SOLAR_OS_KEY_END);
SOLAR_OS_SCRIPT_API_INT(tui, KEY_DELETE, SOLAR_OS_KEY_DELETE);
SOLAR_OS_SCRIPT_API_INT(tui, KEY_ESCAPE, SOLAR_OS_KEY_ESCAPE);
SOLAR_OS_SCRIPT_API_INT(tui, KEY_CTRL, SOLAR_OS_KEY_CTRL);
SOLAR_OS_SCRIPT_API_INT(tui, KEY_AUDIO_MUTE_TOGGLE, SOLAR_OS_KEY_AUDIO_MUTE_TOGGLE);
SOLAR_OS_SCRIPT_API_INT(tui, KEY_PAGE_UP, SOLAR_OS_KEY_PAGE_UP);
SOLAR_OS_SCRIPT_API_INT(tui, KEY_PAGE_DOWN, SOLAR_OS_KEY_PAGE_DOWN);
SOLAR_OS_SCRIPT_API_INT(tui, INPUT_NONE, SOLAR_OS_TUI_INPUT_NONE);
SOLAR_OS_SCRIPT_API_INT(tui, INPUT_CHANGED, SOLAR_OS_TUI_INPUT_CHANGED);
SOLAR_OS_SCRIPT_API_INT(tui, INPUT_SUBMIT, SOLAR_OS_TUI_INPUT_SUBMIT);
SOLAR_OS_SCRIPT_API_INT(tui, INPUT_CANCEL, SOLAR_OS_TUI_INPUT_CANCEL);
SOLAR_OS_SCRIPT_API_FUNCTION(tui, rows, rows);
SOLAR_OS_SCRIPT_API_FUNCTION(tui, cols, cols);
SOLAR_OS_SCRIPT_API_FUNCTION(tui, size, size);
SOLAR_OS_SCRIPT_API_FUNCTION(tui, clear, clear);
SOLAR_OS_SCRIPT_API_FUNCTION(tui, refresh, refresh);
SOLAR_OS_SCRIPT_API_FUNCTION(tui, move, move);
SOLAR_OS_SCRIPT_API_FUNCTION(tui, write, write);
SOLAR_OS_SCRIPT_API_FUNCTION(tui, addstr, addstr);
SOLAR_OS_SCRIPT_API_FUNCTION(tui, putch, putch);
SOLAR_OS_SCRIPT_API_FUNCTION(tui, hline, hline);
SOLAR_OS_SCRIPT_API_FUNCTION(tui, vline, vline);
SOLAR_OS_SCRIPT_API_FUNCTION(tui, vrule, vrule);
SOLAR_OS_SCRIPT_API_FUNCTION(tui, box, box);
SOLAR_OS_SCRIPT_API_FUNCTION(tui, fill, fill);
SOLAR_OS_SCRIPT_API_FUNCTION(tui, layout, layout);
SOLAR_OS_SCRIPT_API_FUNCTION(tui, cell, cell);
SOLAR_OS_SCRIPT_API_FUNCTION(tui, title, title);
SOLAR_OS_SCRIPT_API_FUNCTION(tui, help, help);
SOLAR_OS_SCRIPT_API_FUNCTION(tui, tab, tab);
SOLAR_OS_SCRIPT_API_FUNCTION(tui, list_move, list_move);
SOLAR_OS_SCRIPT_API_FUNCTION(tui, input_edit, input_edit);
SOLAR_OS_SCRIPT_API_FUNCTION(tui, input, input);
SOLAR_OS_SCRIPT_API_FUNCTION(tui, getch, getch);
SOLAR_OS_SCRIPT_API_MODULE_END(tui);

SOLAR_OS_SCRIPT_API_MODULE_BEGIN(gfx);
SOLAR_OS_SCRIPT_API_INT(gfx, WHITE, SOLAR_OS_GFX_COLOR_WHITE);
SOLAR_OS_SCRIPT_API_INT(gfx, LIGHT, SOLAR_OS_GFX_COLOR_LIGHT);
SOLAR_OS_SCRIPT_API_INT(gfx, DARK, SOLAR_OS_GFX_COLOR_DARK);
SOLAR_OS_SCRIPT_API_INT(gfx, BLACK, SOLAR_OS_GFX_COLOR_BLACK);
SOLAR_OS_SCRIPT_API_INT(gfx, GRAY_MAX, SOLAR_OS_GFX_GRAY_MAX);
SOLAR_OS_SCRIPT_API_INT(gfx, FONT_SMALL, SOLAR_OS_GFX_FONT_SMALL);
SOLAR_OS_SCRIPT_API_INT(gfx, FONT_MONO, SOLAR_OS_GFX_FONT_MONO);
SOLAR_OS_SCRIPT_API_INT(gfx, FONT_BOLD, SOLAR_OS_GFX_FONT_BOLD);
SOLAR_OS_SCRIPT_API_INT(gfx, FONT_MONO_12, SOLAR_OS_GFX_FONT_MONO_12);
SOLAR_OS_SCRIPT_API_INT(gfx, FONT_MONO_14, SOLAR_OS_GFX_FONT_MONO_14);
SOLAR_OS_SCRIPT_API_INT(gfx, FONT_MONO_16, SOLAR_OS_GFX_FONT_MONO_16);
SOLAR_OS_SCRIPT_API_INT(gfx, FONT_MONO_18, SOLAR_OS_GFX_FONT_MONO_18);
SOLAR_OS_SCRIPT_API_INT(gfx, FONT_MONO_20, SOLAR_OS_GFX_FONT_MONO_20);
SOLAR_OS_SCRIPT_API_INT(gfx, FONT_BOLD_12, SOLAR_OS_GFX_FONT_BOLD_12);
SOLAR_OS_SCRIPT_API_INT(gfx, FONT_BOLD_14, SOLAR_OS_GFX_FONT_BOLD_14);
SOLAR_OS_SCRIPT_API_INT(gfx, FONT_BOLD_16, SOLAR_OS_GFX_FONT_BOLD_16);
SOLAR_OS_SCRIPT_API_INT(gfx, FONT_BOLD_18, SOLAR_OS_GFX_FONT_BOLD_18);
SOLAR_OS_SCRIPT_API_INT(gfx, FONT_BOLD_20, SOLAR_OS_GFX_FONT_BOLD_20);
SOLAR_OS_SCRIPT_API_INT(gfx, FONT_ITALIC_12, SOLAR_OS_GFX_FONT_ITALIC_12);
SOLAR_OS_SCRIPT_API_INT(gfx, FONT_ITALIC_14, SOLAR_OS_GFX_FONT_ITALIC_14);
SOLAR_OS_SCRIPT_API_INT(gfx, FONT_ITALIC_16, SOLAR_OS_GFX_FONT_ITALIC_16);
SOLAR_OS_SCRIPT_API_INT(gfx, FONT_ITALIC_18, SOLAR_OS_GFX_FONT_ITALIC_18);
SOLAR_OS_SCRIPT_API_INT(gfx, FONT_ITALIC_20, SOLAR_OS_GFX_FONT_ITALIC_20);
SOLAR_OS_SCRIPT_API_INT(gfx, FONT_BOLD_ITALIC_12, SOLAR_OS_GFX_FONT_BOLD_ITALIC_12);
SOLAR_OS_SCRIPT_API_INT(gfx, FONT_BOLD_ITALIC_14, SOLAR_OS_GFX_FONT_BOLD_ITALIC_14);
SOLAR_OS_SCRIPT_API_INT(gfx, FONT_BOLD_ITALIC_16, SOLAR_OS_GFX_FONT_BOLD_ITALIC_16);
SOLAR_OS_SCRIPT_API_INT(gfx, FONT_BOLD_ITALIC_18, SOLAR_OS_GFX_FONT_BOLD_ITALIC_18);
SOLAR_OS_SCRIPT_API_INT(gfx, FONT_BOLD_ITALIC_20, SOLAR_OS_GFX_FONT_BOLD_ITALIC_20);
SOLAR_OS_SCRIPT_API_INT(gfx, KEY_UP, SOLAR_OS_KEY_UP);
SOLAR_OS_SCRIPT_API_INT(gfx, KEY_DOWN, SOLAR_OS_KEY_DOWN);
SOLAR_OS_SCRIPT_API_INT(gfx, KEY_LEFT, SOLAR_OS_KEY_LEFT);
SOLAR_OS_SCRIPT_API_INT(gfx, KEY_RIGHT, SOLAR_OS_KEY_RIGHT);
SOLAR_OS_SCRIPT_API_INT(gfx, KEY_CTRL_LEFT, SOLAR_OS_KEY_CTRL_LEFT);
SOLAR_OS_SCRIPT_API_INT(gfx, KEY_CTRL_RIGHT, SOLAR_OS_KEY_CTRL_RIGHT);
SOLAR_OS_SCRIPT_API_INT(gfx, KEY_HOME, SOLAR_OS_KEY_HOME);
SOLAR_OS_SCRIPT_API_INT(gfx, KEY_END, SOLAR_OS_KEY_END);
SOLAR_OS_SCRIPT_API_INT(gfx, KEY_DELETE, SOLAR_OS_KEY_DELETE);
SOLAR_OS_SCRIPT_API_INT(gfx, KEY_ESCAPE, SOLAR_OS_KEY_ESCAPE);
SOLAR_OS_SCRIPT_API_INT(gfx, KEY_CTRL, SOLAR_OS_KEY_CTRL);
SOLAR_OS_SCRIPT_API_INT(gfx, KEY_AUDIO_MUTE_TOGGLE, SOLAR_OS_KEY_AUDIO_MUTE_TOGGLE);
SOLAR_OS_SCRIPT_API_INT(gfx, KEY_PAGE_UP, SOLAR_OS_KEY_PAGE_UP);
SOLAR_OS_SCRIPT_API_INT(gfx, KEY_PAGE_DOWN, SOLAR_OS_KEY_PAGE_DOWN);
SOLAR_OS_SCRIPT_API_FUNCTION(gfx, begin, begin);
SOLAR_OS_SCRIPT_API_FUNCTION(gfx, end, end);
SOLAR_OS_SCRIPT_API_FUNCTION(gfx, width, width);
SOLAR_OS_SCRIPT_API_FUNCTION(gfx, height, height);
SOLAR_OS_SCRIPT_API_FUNCTION(gfx, size, size);
SOLAR_OS_SCRIPT_API_FUNCTION(gfx, clear, clear);
SOLAR_OS_SCRIPT_API_FUNCTION(gfx, gray, gray);
SOLAR_OS_SCRIPT_API_FUNCTION(gfx, rgb, rgb);
SOLAR_OS_SCRIPT_API_FUNCTION(gfx, color, color);
SOLAR_OS_SCRIPT_API_FUNCTION(gfx, set_color, color);
SOLAR_OS_SCRIPT_API_FUNCTION(gfx, font, font);
SOLAR_OS_SCRIPT_API_FUNCTION(gfx, set_font, font);
SOLAR_OS_SCRIPT_API_FUNCTION(gfx, present, present);
SOLAR_OS_SCRIPT_API_FUNCTION(gfx, refresh, present);
SOLAR_OS_SCRIPT_API_FUNCTION(gfx, pixel, pixel);
SOLAR_OS_SCRIPT_API_FUNCTION(gfx, line, line);
SOLAR_OS_SCRIPT_API_FUNCTION(gfx, rect, rect);
SOLAR_OS_SCRIPT_API_FUNCTION(gfx, fill_rect, fill_rect);
SOLAR_OS_SCRIPT_API_FUNCTION(gfx, circle, circle);
SOLAR_OS_SCRIPT_API_FUNCTION(gfx, fill_circle, fill_circle);
SOLAR_OS_SCRIPT_API_FUNCTION(gfx, bitmap, bitmap);
SOLAR_OS_SCRIPT_API_FUNCTION(gfx, sprite, bitmap);
SOLAR_OS_SCRIPT_API_FUNCTION(gfx, text, text);
SOLAR_OS_SCRIPT_API_FUNCTION_NAMED(
    gfx, getch, solaros_tui_getch_obj, solua_tui_getch);
SOLAR_OS_SCRIPT_API_MODULE_END(gfx);
